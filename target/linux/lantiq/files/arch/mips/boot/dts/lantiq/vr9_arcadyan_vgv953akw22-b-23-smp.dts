// SPDX-License-Identifier: GPL-2.0-or-later OR MIT
/dts-v1/;

#include "vr9_arcadyan_vgv953akw22-b-23.dtsi"

/ {
	compatible = "arcadyan,vgv953akw22-b-23-smp", "arcadyan,vgv953akw22-b-23", "arcadyan,vgv953akw22", "lantiq,xway", "lantiq,vr9";
	model = "Telekom Speedport W 921v";
	
	chosen {
		bootargs = "console=ttyLTQ0,115200";
	};
};

